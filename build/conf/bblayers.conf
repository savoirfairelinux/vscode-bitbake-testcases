## build/conf/bblayers.conf
```bitbake
# Suggestions should be made when typing variables

# Hovering BBPATH should show its definition (https://docs.yoctoproject.org/bitbake/2.4/bitbake-user-manual/bitbake-user-manual-ref-variables.html#term-BBPATH)
# Hovering TOPDIR should show its definition (https://docs.yoctoproject.org/bitbake/2.4/bitbake-user-manual/bitbake-user-manual-ref-variables.html#term-TOPDIR)
BBPATH := "${TOPDIR}"

# Hovering BBFILES should show its definition (https://docs.yoctoproject.org/bitbake/2.4/bitbake-user-manual/bitbake-user-manual-ref-variables.html#term-BBFILES)
BBFILES ?= ""

# Hovering BBLAYERS should show its definition (https://docs.yoctoproject.org/current/ref-manual/variables.html?highlight=bblayers#term-BBLAYERS)
# Clicking on the path should bring to the file
BBLAYERS = "\
    ${TOPDIR}/../meta-one \
    ${TOPDIR}/../meta-two \
"

LAYERSERIES_CORENAMES = "bitbakeexample"
```

## meta-one/conf/layer.conf
```bitbake
# Hovering LAYERDIR should show its definition (https://docs.yoctoproject.org/ref-manual/variables.html?highlight=tmpdir#term-LAYERDIR)
BBPATH .= ":${LAYERDIR}"
BBFILES += "${LAYERDIR}/recipes-*/*/*.bb"

BBFILE_COLLECTIONS += "one"
# "BBFILE_PATTERN" and "one" should be highlighted differently
# Should clicking on "one" bring to BBFILE_COLLECTIONS?
# "one" should be marked as an error if it is not defined in BBFILE_COLLECTIONS
BBFILE_PATTERN_one = "^${LAYERDIR}/"
BBFILE_PRIORITY_one = "5"

# Should suggest layer serie names on typing
LAYERSERIES_COMPAT_one = "bitbakeexample"
```

## meta-three/conf/distro/exampledistro.conf
```bitbake
DISTROOVERRIDES =. "poky:"
require conf/distro/poky.conf
# fslc-base.inc reverses the order of the layers so we can't prepend

DISTRO = "example"
DISTRO_NAME = "Example distro"
DISTRO_VERSION = "1.0"

DISTRO_FEATURES += "wayland pam"
```

## meta-three/conf/machine/examplemachine.conf
```bitbake
MACHINEOVERRIDES =. "qemux86-64:"
require conf/machine/qemux86-64.conf

MACHINE_FEATURES += "bluetooth"
```

## meta-two/conf/layer.conf
```bitbake
BBPATH .= ":${LAYERDIR}"
BBFILES += "\
    ${LAYERDIR}/recipes-*/*/*.bb \
    ${LAYERDIR}/recipes-*/*/*.bbappend \
"

BBFILE_COLLECTIONS += "two"
BBFILE_PATTERN_two = "^${LAYERDIR}/"
BBFILE_PRIORITY_two = "5"
LAYERVERSION_two = "1"
# Should suggest layer names on typing
LAYERDEPENDS_two = "one"

LAYERSERIES_COMPAT_two = "bitbakeexample"
```
